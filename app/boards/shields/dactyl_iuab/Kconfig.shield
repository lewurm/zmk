## app/boards/shields/dactyl_iuab/Kconfig.shield
```kconfig
# Copyright (c) 2020 Pete Johanson
# SPDX-License-Identifier: MIT

config SHIELD_DACTYL_IUAB_LEFT
	def_bool $(shields_list_contains,dactyl_iuab_left)

config SHIELD_DACTYL_IUAB_RIGHT
	def_bool $(shields_list_contains,dactyl_iuab_right)
```

## app/dts/bindings/behaviors/zmk,behavior-sensor-rotate-super-tab.yaml
```yaml
# Copyright (c) 2020 The ZMK Contributors
# SPDX-License-Identifier: MIT

description: Sensor rotate super tab behavior

compatible: "zmk,behavior-sensor-rotate-super-tab"

properties:
  label:
    type: string
    required: true
  "#sensor-binding-cells":
    type: int
    required: true
    const: 2

sensor-binding-cells:
  - param1
  - param2
```
